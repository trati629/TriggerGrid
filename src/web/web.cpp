// web.cpp — see web.h.

#include "web.h"

#include <Arduino.h>
#include <ArduinoJson.h>
#include <LittleFS.h>
#include <Preferences.h>
#include <WebServer.h>

#include "actions/actions.h"
#include "config/config.h"
#include "config/pad_parse.h"
#include "hid/hid.h"
#include "net/net.h"
#include "version.h"
#include "web_assets.h"   // generated by tools/embed_web.py

constexpr size_t SMALL_BODY_MAX = 4 * 1024;   // every route except PUT /api/config
constexpr uint32_t REBOOT_DELAY_MS = 800;     // let the response reach the browser first

static WebServer s_server(80);
static uint32_t  s_reboot_at = 0;

// ---- helpers ------------------------------------------------------------------

static void send_error(int code, const char* message) {
    char body[160];
    snprintf(body, sizeof(body), "{\"error\":\"%s\"}", message);
    s_server.send(code, "application/json", body);
}

static void send_no_content() {
    s_server.send(204);
}

// Append `s` as a JSON string (with quotes) to `out`. For SSIDs and names,
// which can contain quotes or backslashes.
static void append_json_string(String& out, const char* s) {
    out += '"';
    for (; *s; s++) {
        char c = *s;
        if (c == '"' || c == '\\') {
            out += '\\';
            out += c;
        } else if ((uint8_t)c < 0x20) {
            char esc[8];
            snprintf(esc, sizeof(esc), "\\u%04x", c);
            out += esc;
        } else {
            out += c;
        }
    }
    out += '"';
}

// ---- web PIN ------------------------------------------------------------------

static String saved_pin() {
    Preferences prefs;
    prefs.begin("web", true);
    String pin = prefs.getString("pin", "");
    prefs.end();
    return pin;
}

// Every /api/* route needs the PIN, if one is set (header X-TG-Pin).
static bool authorised() {
    String pin = saved_pin();
    if (pin.isEmpty() || s_server.header("X-TG-Pin") == pin) {
        return true;
    }
    send_error(401, "PIN required");
    return false;
}

// ---- small request bodies -----------------------------------------------------
// WebServer hands a non-form body to the route's second callback in chunks.
// Small routes collect it into this buffer; anything larger is dropped and
// answered with 413.

static char   s_body[SMALL_BODY_MAX + 1];
static size_t s_body_len = 0;
static bool   s_body_too_big = false;

static void collect_small_body() {
    HTTPRaw& raw = s_server.raw();
    if (raw.status == RAW_START) {
        s_body_len = 0;
        s_body_too_big = s_server.clientContentLength() > (int)SMALL_BODY_MAX;
    } else if (raw.status == RAW_WRITE && !s_body_too_big) {
        if (s_body_len + raw.currentSize > SMALL_BODY_MAX) {
            s_body_too_big = true;
        } else {
            memcpy(s_body + s_body_len, raw.buf, raw.currentSize);
            s_body_len += raw.currentSize;
        }
    }
    s_body[s_body_len] = '\0';
}

// Parse the collected body as JSON. Sends the error response itself.
static bool small_body_json(JsonDocument& doc) {
    if (s_body_too_big) {
        send_error(413, "request too large");
        return false;
    }
    if (deserializeJson(doc, s_body, s_body_len)) {
        send_error(400, "not valid JSON");
        return false;
    }
    return true;
}

// ---- static files -------------------------------------------------------------

// The web app, straight from flash. The ETag is the build hash, so a browser
// that already has this firmware's files gets a 304 with no body.
static bool serve_asset(const String& uri) {
    const String path = (uri == "/") ? String("/index.html") : uri;
    for (size_t i = 0; i < kWebAssetCount; i++) {
        const WebAsset& a = kWebAssets[i];
        if (path != a.path) {
            continue;
        }
        const String etag = String("\"") + WEB_BUILD_HASH + "\"";
        s_server.sendHeader("ETag", etag);
        s_server.sendHeader("Cache-Control", "no-cache");
        if (s_server.header("If-None-Match") == etag) {
            s_server.send(304);
            return true;
        }
        if (a.gzipped) {
            s_server.sendHeader("Content-Encoding", "gzip");
        }
        s_server.send_P(200, a.type, (const char*)a.data, a.size);
        return true;
    }
    return false;
}

static void on_not_found() {
    if (s_server.method() == HTTP_GET && serve_asset(s_server.uri())) {
        return;
    }
    send_error(404, "not found");
}

// ---- API: status and config ---------------------------------------------------

static void on_status() {
    if (!authorised()) return;

    const char* mode = net_mode() == NetMode::AccessPoint ? "hotspot"
                     : net_mode() == NetMode::Station     ? "station" : "connecting";
    char ip[20];
    net_ip(ip, sizeof(ip));
    const char* warning = config_warning();

    String out;
    out.reserve(320);
    out += "{\"fw\":\"";
    out += FW_VERSION;
    out += "\",\"padV\":";
    out += PAD_FORMAT_VERSION;
    out += ",\"uptime\":";
    out += millis() / 1000;
    out += ",\"wifi\":{\"mode\":\"";
    out += mode;
    out += "\",\"ssid\":";
    append_json_string(out, net_ssid());
    out += ",\"ip\":\"";
    out += ip;
    out += "\",\"host\":\"";
    out += net_hostname();
    out += "\",\"rssi\":";
    out += net_rssi();
    out += "},\"ble\":{\"connected\":";
    out += hid_connected() ? "true" : "false";
    out += "},\"heap\":";
    out += ESP.getFreeHeap();
    out += ",\"psram\":";
    out += ESP.getFreePsram();
    out += ",\"pin\":";
    out += saved_pin().isEmpty() ? "false" : "true";
    out += ",\"layoutWarning\":";
    if (warning) {
        append_json_string(out, warning);
    } else {
        out += "null";
    }
    out += "}";
    s_server.send(200, "application/json", out);
}

static void on_get_config() {
    if (!authorised()) return;
    File file = LittleFS.open(CONFIG_PATH, "r");
    if (!file) {
        send_error(404, "no config.json yet");   // the page starts from its default layout
        return;
    }
    s_server.streamFile(file, "application/json");   // as stored, no parsing
    file.close();
}

// PUT /api/config: stream the body to /config.tmp, check its pad section,
// then rename it over /config.json. A bad file never replaces a good one.
static File s_upload;
static bool s_upload_too_big = false;
static bool s_upload_failed = false;

static void collect_config_body() {
    HTTPRaw& raw = s_server.raw();
    switch (raw.status) {
        case RAW_START:
            s_upload_too_big = s_server.clientContentLength() > (int)CONFIG_MAX_BYTES;
            s_upload_failed = false;
            if (!s_upload_too_big) {
                s_upload = LittleFS.open(CONFIG_TMP_PATH, "w");
                s_upload_failed = !s_upload;
            }
            break;
        case RAW_WRITE:
            if (s_upload && !s_upload_too_big) {
                if (raw.totalSize > CONFIG_MAX_BYTES) {
                    s_upload_too_big = true;
                } else if (s_upload.write(raw.buf, raw.currentSize) != raw.currentSize) {
                    s_upload_failed = true;
                }
            }
            break;
        case RAW_END:
        case RAW_ABORTED:
            if (s_upload) {
                s_upload.close();
            }
            if (raw.status == RAW_ABORTED) {
                s_upload_failed = true;
            }
            break;
    }
}

static void on_put_config() {
    if (!authorised()) {
        LittleFS.remove(CONFIG_TMP_PATH);
        return;
    }
    if (s_upload_too_big || s_upload_failed) {
        LittleFS.remove(CONFIG_TMP_PATH);
        send_error(s_upload_too_big ? 413 : 500, s_upload_too_big ? "layout larger than 32 KB" : "could not store the file");
        return;
    }
    const char* problem = config_check_file(CONFIG_TMP_PATH);
    if (problem) {
        LittleFS.remove(CONFIG_TMP_PATH);
        send_error(400, problem);
        return;
    }
    if (!LittleFS.rename(CONFIG_TMP_PATH, CONFIG_PATH)) {
        send_error(500, "could not replace config.json");
        return;
    }
    config_mark_dirty();   // loop() reloads and rebuilds the screens
    send_no_content();
}

// ---- API: actions, Wi-Fi, Bluetooth, PIN, reboot --------------------------------

// POST /api/test: run one compiled action now, without saving ("Try it").
static void on_test() {
    if (!authorised()) return;
    JsonDocument doc;
    if (!small_body_json(doc)) return;

    // A 4 KB body holds at most ~1000 keystrokes; PSRAM, freed below.
    const size_t capacity = SMALL_BODY_MAX / 4;
    uint16_t* strokes = (uint16_t*)ps_malloc(capacity * sizeof(uint16_t));
    if (!strokes) {
        send_error(500, "out of memory");
        return;
    }
    memset(strokes, 0, capacity * sizeof(uint16_t));
    StrokeBuffer buffer = {strokes, capacity, 0};

    PadAction action;
    const char* problem = pad_parse_action(doc.as<JsonObjectConst>(), action, buffer);
    if (problem) {
        send_error(400, problem);
    } else if (!actions_run(action)) {   // copies the keystrokes
        send_error(409, "Bluetooth not connected");
    } else {
        send_no_content();
    }
    free(strokes);
}

static void on_scan_start() {
    if (!authorised()) return;
    net_scan_start();
    s_server.send(202, "application/json", "{\"scanning\":true}");
}

static void on_scan_results() {
    if (!authorised()) return;
    int count = net_scan_count();
    if (count < 0) {
        s_server.send(200, "application/json", "{\"scanning\":true}");
        return;
    }
    String out = "{\"scanning\":false,\"networks\":[";
    for (int i = 0; i < count && i < 20; i++) {
        char ssid[33];
        int rssi;
        bool secure;
        if (!net_scan_entry(i, ssid, sizeof(ssid), &rssi, &secure) || !ssid[0]) {
            continue;
        }
        if (out[out.length() - 1] == '}') out += ',';
        out += "{\"ssid\":";
        append_json_string(out, ssid);
        out += ",\"rssi\":";
        out += rssi;
        out += ",\"secure\":";
        out += secure ? "true" : "false";
        out += '}';
    }
    out += "]}";
    s_server.send(200, "application/json", out);
}

static void on_set_wifi() {
    if (!authorised()) return;
    JsonDocument doc;
    if (!small_body_json(doc)) return;
    const char* ssid = doc["ssid"] | "";
    const char* password = doc["password"] | "";
    if (!ssid[0] || strlen(ssid) > 32 || strlen(password) > 64) {
        send_error(400, "SSID must be 1-32 bytes, password up to 64");
        return;
    }
    net_save_credentials(ssid, password);
    send_no_content();
    s_reboot_at = millis() + REBOOT_DELAY_MS;   // join the new network on restart
}

static void on_forget_ble() {
    if (!authorised()) return;
    hid_forget_bonds();
    send_no_content();
}

// POST /api/pin {"old", "new"}: set, change or clear ("new": "") the PIN.
static void on_set_pin() {
    if (!authorised()) return;
    JsonDocument doc;
    if (!small_body_json(doc)) return;
    const String old_pin = doc["old"] | "";
    const String new_pin = doc["new"] | "";
    const String current = saved_pin();
    if (!current.isEmpty() && old_pin != current) {
        send_error(403, "current PIN is wrong");
        return;
    }
    bool digits = true;
    for (char c : new_pin) digits = digits && isdigit((unsigned char)c);
    if (!new_pin.isEmpty() && (!digits || new_pin.length() < 4 || new_pin.length() > 8)) {
        send_error(400, "PIN must be 4-8 digits");
        return;
    }
    Preferences prefs;
    prefs.begin("web", false);
    prefs.putString("pin", new_pin);
    prefs.end();
    send_no_content();
}

static void on_reboot() {
    if (!authorised()) return;
    send_no_content();
    s_reboot_at = millis() + REBOOT_DELAY_MS;
}

// ---- task ---------------------------------------------------------------------

static void web_task(void*) {
    for (;;) {
        s_server.handleClient();
        if (s_reboot_at && (int32_t)(millis() - s_reboot_at) >= 0) {
            ESP.restart();
        }
        vTaskDelay(pdMS_TO_TICKS(2));
    }
}

bool web_begin() {
    static const char* kHeaders[] = {"X-TG-Pin", "If-None-Match"};
    s_server.collectHeaders(kHeaders, 2);

    s_server.on("/api/status", HTTP_GET, on_status);
    s_server.on("/api/config", HTTP_GET, on_get_config);
    s_server.on("/api/config", HTTP_PUT, on_put_config, collect_config_body);
    s_server.on("/api/test", HTTP_POST, on_test, collect_small_body);
    s_server.on("/api/wifi/scan", HTTP_POST, on_scan_start);
    s_server.on("/api/wifi/scan", HTTP_GET, on_scan_results);
    s_server.on("/api/wifi", HTTP_POST, on_set_wifi, collect_small_body);
    s_server.on("/api/ble/forget", HTTP_POST, on_forget_ble);
    s_server.on("/api/pin", HTTP_POST, on_set_pin, collect_small_body);
    s_server.on("/api/reboot", HTTP_POST, on_reboot);
    s_server.onNotFound(on_not_found);
    s_server.begin();

    // Core 0, priority 1: below Wi-Fi and Bluetooth, so a page load can't
    // delay a keystroke.
    return xTaskCreatePinnedToCore(web_task, "web", 8192, nullptr, 1, nullptr, 0) == pdPASS;
}
